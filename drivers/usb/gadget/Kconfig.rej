## drivers/usb/gadget/Kconfig.rej
```kconfig
--- drivers/usb/gadget/Kconfig
+++ drivers/usb/gadget/Kconfig
@@ -544,7 +544,7 @@
 	select USB_GADGET_SELECTED
 
 config USB_GADGET_EG20T
-	boolean "Intel EG20T PCH/OKI SEMICONDUCTOR ML7213 IOH UDC"
+	tristate "Intel EG20T PCH/OKI SEMICONDUCTOR IOH(ML7213/ML7831) UDC"
 	depends on PCI
 	select USB_GADGET_DUALSPEED
 	help
```

## drivers/video/msm3/Kconfig
```kconfig
config FB_MSM
	tristate "MSM Framebuffer"
	depends on FB && ARCH_MSM
	select FB_CFB_FILLRECT
	select FB_CFB_COPYAREA
	select FB_CFB_IMAGEBLIT
	default y

config FB_MSM_MDP31
	select FB_MSM_LCDC_HW
	bool "MDP HW ver3.1"
	---help---
	  Support for MSM MDP HW revision 3.1
	  Say Y here if this is msm8x50 variant platform.

config FB_MSM_LEGACY_MDP
	bool "MSM Legacy MDP (qsd8k)"
	depends on FB_MSM && (FB_MSM_MDP31 || FB_MSM_MDP22)
	default y

config FB_MSM_MDP_PPP
	bool "MSM MDP PPP"
	depends on FB_MSM_LEGACY_MDP
	default y

config FB_MSM_LCDC
	bool "Support for integrated LCD controller in MDP3/4"
	depends on FB_MSM && (FB_MSM_MDP31 || FB_MSM_MDP40)
	default y

config FB_MSM_MDDI
	bool "Support for MSM MDDI controllers"
	depends on FB_MSM
	default y

config FB_MSM_MDDI_EPSON
	bool "Support for Epson MDDI panels"
	depends on FB_MSM_MDDI
	default n

config FB_MSM_MDDI_NOVTEC
	bool "Support for Novtec MDDI panels"
	depends on FB_MSM_MDDI
	default n

config MSM_HDMI
	bool "Support for HDMI in QCT platform"
	depends on FB_MSM_MDP31
	default n
```
